// VPU PCM stream: raw PDM from the VPU over I2S, decimated to PCM in software
//
// Board:  XIAO ESP32-C6 (Seeed), ESP32 Arduino core 3.x
// Wiring: VPU CLK -> D6, VPU DATA -> D7 (same as firmware/vpu_lab_demo)
// Tools menu: USB CDC On Boot -> Enabled   (otherwise nothing appears on USB)
//
// The C6's I2S can read PDM but has no hardware PDM-to-PCM filter, so the raw 1-bit
// stream is decimated by 64 here: a CIC (order 5, /16) then a 90-tap FIR (/4). The
// filters are in pdm_filters.h, generated by `python -m everyday_sensing.pdm_decimator`,
// which is also the bit-exact reference model.
//
// PDM_CLOCK_HZ 3072000 gives 48 kHz PCM; 1536000 gives 24 kHz. Both are in the
// sensor's legal high-resolution clock bands.
//
// Single-character commands over USB serial:
//   S       stats mode (default): one text line per second
//   B       binary mode: PCM frames (see README.md for the format)
//   V       layout self-test: the same raw data decimated with each bit order, with and
//           without dropping duplicate words
//   M / L   bit order MSB-first / LSB-first      D   toggle duplicate-word dropping
//   l / r   PDM slot left / right (which clock edge the sensor drives)

#pragma GCC optimize("O2")

#include <Arduino.h>
#include "driver/i2s_pdm.h"
#include "esp_timer.h"
#include "pdm_filters.h"

#ifndef PDM_CLOCK_HZ
#define PDM_CLOCK_HZ 3072000
#endif

const uint32_t DECIMATION = 64;
const uint32_t FS_OUT = PDM_CLOCK_HZ / DECIMATION;
const int BLOCK_WORDS = 1024;                                // 16,384 PDM bits
const int BLOCK_BYTES = BLOCK_WORDS * 2;
const int OUT_PER_BLOCK = BLOCK_WORDS * 16 / DECIMATION;      // at most 256 samples
const int TEST_BLOCKS = 48;                                   // self-test length
const int TEST_SKIP = 64;                                     // filter warm-up samples
const uint32_t FRAME_SYNC = 0xA55A5AA5;

i2s_chan_handle_t rx = NULL;
volatile uint32_t ovfCount = 0;
i2s_pdm_slot_mask_t slot = I2S_PDM_SLOT_LEFT;
bool msbFirst = true;
// In mono raw PDM mode the driver was seen to deliver every 16-bit word twice (equal
// pairs, twice the expected byte rate). dedupe keeps only the first word of each pair;
// the stats line reports the fraction of equal pairs so this can be checked.
bool dedupe = true;
bool binaryMode = false;

uint16_t raw[BLOCK_WORDS];
uint8_t ordered[BLOCK_BYTES];
int16_t pcm[OUT_PER_BLOCK + 4];
uint8_t REV8[256];
uint16_t CRC_TABLE[256];


// ---------------------------------------------------------------- decimator

struct Decimator {
  uint8_t bytes[PDM_LUT_BYTES + BLOCK_BYTES];
  int carry = 0;                        // unconsumed bytes kept from the previous block
  int32_t x[PDM_FIR_TAPS + BLOCK_WORDS + 4];
  int nx = 0;                           // stage 2 inputs not yet consumed

  void reset() {
    carry = 0;
    nx = 0;
  }

  // Time-ordered PDM bytes in, int16 PCM out; returns the number of samples written.
  int process(const uint8_t* in, int nBytes, int16_t* out) {
    memcpy(bytes + carry, in, nBytes);
    int total = carry + nBytes;
    int off = 0;
    while (off + PDM_LUT_BYTES <= total) {
      const uint8_t* b = bytes + off;
      int32_t y = 0;
      for (int p = 0; p < PDM_LUT_BYTES; p++) {
        y += PDM_LUT[p][b[p]];
      }
      x[nx++] = (2 * y - PDM_CIC_FULL_SCALE) >> PDM_X_SHIFT;
      off += 2;
    }
    carry = total - off;
    memmove(bytes, bytes + off, carry);

    int n = 0;
    int k = 0;
    while (k + PDM_FIR_TAPS <= nx) {
      const int32_t* xi = x + k;
      int32_t acc = 0;
      for (int j = 0; j < PDM_FIR_TAPS; j++) {
        acc += PDM_FIR[j] * xi[j];
      }
      int32_t v = (acc + (1 << (PDM_OUT_SHIFT - 1))) >> PDM_OUT_SHIFT;
      out[n++] = (int16_t)constrain(v, -32768, 32767);
      k += 4;
    }
    nx -= k;
    memmove(x, x + k, nx * sizeof(int32_t));
    return n;
  }
};

Decimator dec;


// Returns the number of bytes written to out.
int orderBytes(const uint16_t* w, int nWords, uint8_t* out, bool msb, bool dedup) {
  int step = dedup ? 2 : 1;
  int n = nWords / step;
  for (int i = 0; i < n; i++) {
    uint16_t v = w[i * step];
    if (msb) {
      out[2 * i] = v >> 8;
      out[2 * i + 1] = v & 0xFF;
    } else {
      out[2 * i] = REV8[v & 0xFF];
      out[2 * i + 1] = REV8[v >> 8];
    }
  }
  return 2 * n;
}


uint16_t crc16(const uint8_t* data, size_t n, uint16_t crc) {
  for (size_t i = 0; i < n; i++) {
    crc = (crc << 8) ^ CRC_TABLE[((crc >> 8) ^ data[i]) & 0xFF];
  }
  return crc;
}


// ---------------------------------------------------------------- I2S

static bool IRAM_ATTR onOverflow(i2s_chan_handle_t, i2s_event_data_t*, void*) {
  ovfCount++;
  return false;
}

i2s_pdm_rx_slot_config_t slotConfig() {
  i2s_pdm_rx_slot_config_t cfg =
      I2S_PDM_RX_SLOT_RAW_FMT_DEFAULT_CONFIG(I2S_DATA_BIT_WIDTH_16BIT, I2S_SLOT_MODE_MONO);
  cfg.slot_mask = slot;
  return cfg;
}

bool startI2s() {
  i2s_chan_config_t chan = I2S_CHANNEL_DEFAULT_CONFIG(I2S_NUM_0, I2S_ROLE_MASTER);
  chan.dma_desc_num = 8;
  chan.dma_frame_num = 512;
  if (i2s_new_channel(&chan, NULL, &rx) != ESP_OK) {
    return false;
  }
  i2s_pdm_rx_config_t cfg = {};
  cfg.clk_cfg = I2S_PDM_RX_CLK_DEFAULT_CONFIG(PDM_CLOCK_HZ);
  cfg.slot_cfg = slotConfig();
  cfg.gpio_cfg.clk = (gpio_num_t)D6;
  cfg.gpio_cfg.din = (gpio_num_t)D7;
  if (i2s_channel_init_pdm_rx_mode(rx, &cfg) != ESP_OK) {
    return false;
  }
  i2s_event_callbacks_t cbs = {};
  cbs.on_recv_q_ovf = onOverflow;
  i2s_channel_register_event_callback(rx, &cbs, NULL);
  return i2s_channel_enable(rx) == ESP_OK;
}

void setSlot(i2s_pdm_slot_mask_t s) {
  slot = s;
  i2s_channel_disable(rx);
  i2s_pdm_rx_slot_config_t cfg = slotConfig();
  i2s_channel_reconfig_pdm_rx_slot(rx, &cfg);
  i2s_channel_enable(rx);
}

bool readBlock(uint16_t* dst) {
  size_t got = 0;
  return i2s_channel_read(rx, dst, BLOCK_BYTES, &got, 1000) == ESP_OK && got == BLOCK_BYTES;
}


// ---------------------------------------------------------------- reporting

const char* layoutName(bool msb, bool dedup) {
  if (msb) return dedup ? "msb" : "msb+dups";
  return dedup ? "lsb" : "lsb+dups";
}

// Decimates the same raw capture with all four layouts (bit order x duplicate dropping) and prints the output
// noise of each. With the sensor still, the right layout is the one with the lowest RMS.
void selfTest() {
  uint16_t* cap = (uint16_t*)malloc(TEST_BLOCKS * BLOCK_BYTES);
  if (!cap) {
    Serial.println("# self-test: out of memory");
    return;
  }
  for (int b = 0; b < TEST_BLOCKS; b++) {
    if (!readBlock(cap + b * BLOCK_WORDS)) {
      Serial.println("# self-test: I2S read failed");
      free(cap);
      return;
    }
  }
  Serial.printf("# self-test, slot %s (keep the sensor still)\n",
                slot == I2S_PDM_SLOT_LEFT ? "left" : "right");
  double best = 1e30;
  bool bestMsb = true, bestDedup = true;
  for (int v = 0; v < 4; v++) {
    bool msb = v < 2;
    bool dedup = !(v & 1);
    dec.reset();
    int64_t sum = 0, sumsq = 0;
    int count = 0, seen = 0;
    for (int b = 0; b < TEST_BLOCKS; b++) {
      int nb = orderBytes(cap + b * BLOCK_WORDS, BLOCK_WORDS, ordered, msb, dedup);
      int n = dec.process(ordered, nb, pcm);
      for (int i = 0; i < n; i++, seen++) {
        if (seen < TEST_SKIP) continue;
        sum += pcm[i];
        sumsq += (int64_t)pcm[i] * pcm[i];
        count++;
      }
    }
    double mean = (double)sum / count;
    double rms = sqrt((double)sumsq / count - mean * mean);
    Serial.printf("# layout %-8s samples %6d  mean %9.2f  rms %9.2f\n", layoutName(msb, dedup),
                  count, mean, rms);
    if (rms < best) {
      best = rms;
      bestMsb = msb;
      bestDedup = dedup;
    }
  }
  Serial.printf("# lowest noise: %s (current setting %s)\n", layoutName(bestMsb, bestDedup),
                layoutName(msbFirst, dedupe));
  free(cap);
  dec.reset();
}


struct Stats {
  uint32_t blocks = 0, samples = 0;
  int64_t sum = 0, sumsq = 0;
  int32_t peak = 0;
  uint64_t ones = 0;
  uint32_t pairs = 0, equalPairs = 0;
  uint64_t procUs = 0;
  uint32_t procMax = 0;
  uint32_t txShort = 0;
  void reset() { *this = Stats(); }
};

Stats st;
uint64_t statsStart = 0;
uint32_t ovfAtStats = 0;
uint32_t samplesOut = 0;   // total PCM samples produced since the stream (re)started

void printStats() {
  uint64_t now = esp_timer_get_time();
  double elapsedUs = (double)(now - statsStart);
  double mean = st.samples ? (double)st.sum / st.samples : 0;
  double rms = st.samples ? sqrt((double)st.sumsq / st.samples - mean * mean) : 0;
  double bits = (double)st.blocks * BLOCK_WORDS * 16;
  Serial.printf(
      "stats t_s=%.1f pdm_hz=%d bytes_per_s=%.0f equal_pairs=%.4f pcm_per_s=%.0f ovf=%lu "
      "cpu_pct=%.1f proc_us_max=%lu ones=%.4f mean=%.1f rms=%.1f peak=%ld layout=%s slot=%s\n",
      now / 1e6, PDM_CLOCK_HZ, st.blocks * BLOCK_BYTES * 1e6 / elapsedUs,
      st.pairs ? (double)st.equalPairs / st.pairs : 0, st.samples * 1e6 / elapsedUs,
      (unsigned long)(ovfCount - ovfAtStats), 100.0 * st.procUs / elapsedUs,
      (unsigned long)st.procMax, bits ? st.ones / bits : 0, mean, rms, (long)st.peak,
      layoutName(msbFirst, dedupe), slot == I2S_PDM_SLOT_LEFT ? "left" : "right");
  st.reset();
  statsStart = now;
  ovfAtStats = ovfCount;
}

void restartStream() {
  dec.reset();
  st.reset();
  samplesOut = 0;
  statsStart = esp_timer_get_time();
  ovfAtStats = ovfCount;
}


// ---------------------------------------------------------------- frames

// sync u32 | first_sample u32 | n u16 | ovf u16 | proc_us u16 | n x int16 | crc16
// Little-endian. crc16 is CRC-16/CCITT-FALSE over everything after the sync word.
uint8_t frame[4 + 4 + 2 + 2 + 2 + 2 * (OUT_PER_BLOCK + 4) + 2];

void sendFrame(const int16_t* s, int n, uint32_t procUs) {
  uint8_t* p = frame;
  uint32_t first = samplesOut;
  uint16_t ovf = ovfCount & 0xFFFF;
  uint16_t proc = procUs > 0xFFFF ? 0xFFFF : procUs;
  uint16_t nn = n;
  memcpy(p, &FRAME_SYNC, 4); p += 4;
  memcpy(p, &first, 4); p += 4;
  memcpy(p, &nn, 2); p += 2;
  memcpy(p, &ovf, 2); p += 2;
  memcpy(p, &proc, 2); p += 2;
  memcpy(p, s, 2 * n); p += 2 * n;
  uint16_t crc = crc16(frame + 4, p - frame - 4, 0xFFFF);
  memcpy(p, &crc, 2); p += 2;
  size_t len = p - frame;
  if (Serial.write(frame, len) != len) {
    st.txShort++;
  }
}


// ---------------------------------------------------------------- main

void handleCommands() {
  while (Serial.available()) {
    char c = Serial.read();
    switch (c) {
      case 'S': binaryMode = false; restartStream(); break;
      case 'B': binaryMode = true; restartStream(); break;
      case 'V': if (!binaryMode) selfTest(); restartStream(); break;
      case 'M': msbFirst = true; restartStream(); break;
      case 'L': msbFirst = false; restartStream(); break;
      case 'D': dedupe = !dedupe; restartStream(); break;
      case 'l': setSlot(I2S_PDM_SLOT_LEFT); restartStream(); break;
      case 'r': setSlot(I2S_PDM_SLOT_RIGHT); restartStream(); break;
      default: break;
    }
  }
}

void setup() {
  Serial.setTxBufferSize(8192);
  Serial.setTxTimeoutMs(0);   // never stall on USB: lost frames show up as counter gaps
  Serial.begin(115200);
  delay(1000);
  for (int i = 0; i < 256; i++) {
    uint8_t v = i, r = 0;
    for (int b = 0; b < 8; b++) {
      r = (r << 1) | (v & 1);
      v >>= 1;
    }
    REV8[i] = r;
    uint16_t c = i << 8;
    for (int b = 0; b < 8; b++) {
      c = (c & 0x8000) ? (c << 1) ^ 0x1021 : (c << 1);
    }
    CRC_TABLE[i] = c;
  }

  Serial.println("# VPU PCM stream starting");
  Serial.printf("# pdm_clock_hz = %d\n# fs_out_hz = %lu\n# fir_taps = %d\n",
                PDM_CLOCK_HZ, (unsigned long)FS_OUT, PDM_FIR_TAPS);
  if (!startI2s()) {
    while (1) {
      Serial.println("# ERROR: could not start I2S PDM RX on D6/D7");
      delay(1000);
    }
  }
  delay(500);   // let the sensor start up after the clock begins
  selfTest();
  restartStream();
}

void loop() {
  handleCommands();
  if (!readBlock(raw)) {
    if (!binaryMode) Serial.println("# I2S read timed out");
    return;
  }
  uint64_t t0 = esp_timer_get_time();
  int nb = orderBytes(raw, BLOCK_WORDS, ordered, msbFirst, dedupe);
  int n = dec.process(ordered, nb, pcm);
  for (int i = 0; i < BLOCK_WORDS; i++) {
    st.ones += __builtin_popcount(raw[i]);
  }
  for (int i = 0; i < BLOCK_WORDS; i += 2) {
    st.equalPairs += raw[i] == raw[i + 1];
  }
  st.pairs += BLOCK_WORDS / 2;
  for (int i = 0; i < n; i++) {
    int32_t v = pcm[i];
    st.sum += v;
    st.sumsq += (int64_t)v * v;
    if (abs(v) > st.peak) st.peak = abs(v);
  }
  uint32_t procUs = esp_timer_get_time() - t0;
  st.blocks++;
  st.samples += n;
  st.procUs += procUs;
  if (procUs > st.procMax) st.procMax = procUs;

  if (binaryMode) {
    sendFrame(pcm, n, procUs);
  } else if (esp_timer_get_time() - statsStart >= 1000000) {
    printStats();
  }
  samplesOut += n;
}
